## lab/discord-voice-esp32/main/Kconfig.projbuild
```kconfig
menu "OraclePet Discord voice lab"

    config DVL_WIFI_SSID
        string "WiFi SSID (2.4 GHz)"
        default ""

    config DVL_WIFI_PASSWORD
        string "WiFi password"
        default ""

    config DVL_BOT_TOKEN
        string "Discord bot token (kept only in sdkconfig, which is gitignored)"
        default ""

    config DVL_GUILD_ID
        string "Guild (server) id"
        default ""

    config DVL_CHANNEL_ID
        string "Voice channel id"
        default ""

endmenu
```

## lab/ota-base/sdkconfig.defaults
```kconfig
CONFIG_IDF_TARGET="esp32s3"
CONFIG_ESPTOOLPY_FLASHSIZE_8MB=y
CONFIG_ESPTOOLPY_FLASHMODE_QIO=y
CONFIG_PARTITION_TABLE_CUSTOM=y
CONFIG_PARTITION_TABLE_CUSTOM_FILENAME="partitions.csv"

# Any firmware may follow, and most do not mark themselves valid: no rollback.
CONFIG_BOOTLOADER_APP_ROLLBACK_ENABLE=n

CONFIG_BT_ENABLED=y
CONFIG_BT_NIMBLE_ENABLED=y
CONFIG_BT_CONTROLLER_ENABLED=y
CONFIG_BT_NIMBLE_ROLE_PERIPHERAL=y
CONFIG_BT_NIMBLE_ROLE_BROADCASTER=y
CONFIG_BT_NIMBLE_ROLE_CENTRAL=n
CONFIG_BT_NIMBLE_ROLE_OBSERVER=n
CONFIG_BT_NIMBLE_MAX_CONNECTIONS=1
CONFIG_BT_NIMBLE_ATT_PREFERRED_MTU=517
CONFIG_BT_NIMBLE_SECURITY_ENABLE=n

CONFIG_COMPILER_OPTIMIZATION_SIZE=y
CONFIG_LOG_DEFAULT_LEVEL_INFO=y
CONFIG_ESP_CONSOLE_USB_SERIAL_JTAG=y
```
